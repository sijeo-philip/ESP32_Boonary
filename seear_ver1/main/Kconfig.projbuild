## seear_ver1/main/Kconfig.projbuild
```kconfig
menu "WIFI CONNECT"
    config WIFI_SSID
        string "SSID"
        default "my_ssid"

    config WIFI_PASSWORD
        string "PASSWORD"
        default "my password"
endmenu
```
